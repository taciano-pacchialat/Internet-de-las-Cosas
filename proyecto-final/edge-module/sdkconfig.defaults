## proyecto-final/edge-module/sdkconfig.defaults
```kconfig
# C++ exceptions para RadioLib
CONFIG_COMPILER_CXX_EXCEPTIONS=y
CONFIG_COMPILER_CXX_EXCEPTIONS_EMG_POOL_SIZE=0

# Log
CONFIG_LOG_DEFAULT_LEVEL_INFO=y

# Deep sleep
CONFIG_ESP_SLEEP_GPIO_RESET_WORKAROUND=y

# No hay Wi-Fi en el Edge Module, desactivar para ahorrar flash
# CONFIG_ESP_WIFI_ENABLED is not set
```

## proyecto-final/gateway-module/sdkconfig.defaults
```kconfig
CONFIG_COMPILER_CXX_EXCEPTIONS=y
CONFIG_COMPILER_CXX_EXCEPTIONS_EMG_POOL_SIZE=0
CONFIG_ESP_WIFI_SSID="TU_SSID_AQUI"
CONFIG_ESP_WIFI_PASSWORD="TU_PASSWORD_AQUI"
CONFIG_MQTT_PROTOCOL_311=y
CONFIG_LOG_DEFAULT_LEVEL_INFO=y
CONFIG_ESP_SYSTEM_EVENT_TASK_STACK_SIZE=4096
# CONFIG_SPIRAM is not set
CONFIG_PARTITION_TABLE_CUSTOM=y
CONFIG_PARTITION_TABLE_CUSTOM_FILENAME="partitions.csv"
CONFIG_PARTITION_TABLE_FILENAME="partitions.csv"
CONFIG_PARTITION_TABLE_OFFSET=0x8000
CONFIG_ESPTOOLPY_FLASHSIZE_4MB=y
CONFIG_ESPTOOLPY_FLASHSIZE="4MB"
```
